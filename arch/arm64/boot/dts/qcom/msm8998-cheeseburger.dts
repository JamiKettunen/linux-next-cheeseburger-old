// SPDX-License-Identifier: GPL-2.0
/* Copyright (c) 2016, The Linux Foundation. All rights reserved. */

/dts-v1/;

#include "msm8998-cheeseburger.dtsi"

/ {
	model = "Qualcomm Technologies, Inc. MSM 8998 v2.1 MTP";
	compatible = "qcom,msm8998-mtp", "qcom,msm8998", "qcom,mtp";

	qcom,board-id = <8 0 16859 23>;
};
